## configs/biloba_5.10_defconfig
```kconfig
# Biloba (Redmi Note 8 2021) - MT6768
# Linux 5.10.257 tabanli guncellenmis defconfig
# Kaynak: Xiaomi biloba-r-oss (Android 11) -> 5.10 port

# ============================================
# Temel Kernel Ozellikleri
# ============================================
CONFIG_LOCALVERSION="-biloba-5.10"
# CONFIG_LOCALVERSION_AUTO is not set

# CONFIG_FHANDLE is not set
CONFIG_IKHEADERS=m
CONFIG_IKCONFIG=y
CONFIG_IKCONFIG_PROC=y
CONFIG_LOG_BUF_SHIFT=21

# UCLAMP - 5.10'da mevcut
CONFIG_UCLAMP_TASK=y
CONFIG_UCLAMP_GROUPS_COUNT=32

# Cgroup ve Scheduler
CONFIG_CPUSETS=y
CONFIG_CGROUP_DEBUG=y
CONFIG_SCHED_TUNE=y

# 5.10'da CONFIG_DEFAULT_USE_ENERGY_AWARE yok, yerine:
CONFIG_SCHED_ENERGY=y

# Initramfs sikistirma
# CONFIG_RD_BZIP2 is not set
# CONFIG_RD_LZMA is not set
# CONFIG_RD_XZ is not set
# CONFIG_RD_LZO is not set
# CONFIG_RD_LZ4 is not set
CONFIG_RD_ZSTD=y

CONFIG_SYSCTL_SYSCALL=y
# CONFIG_KALLSYMS_BASE_RELATIVE is not set
# CONFIG_SLUB_DEBUG is not set
CONFIG_CC_STACKPROTECTOR_STRONG=y
CONFIG_MODULE_SRCVERSION_ALL=y

# Block layer
# CONFIG_BLK_DEV_BSG is not set
CONFIG_BLK_INLINE_ENCRYPTION=y
CONFIG_BLK_INLINE_ENCRYPTION_FALLBACK=y

# ============================================
# Platform - ARM64 / Mediatek
# ============================================
CONFIG_ARCH_MEDIATEK=y

# CPU
CONFIG_SCHED_MC=y
CONFIG_NR_CPUS=8
CONFIG_PREEMPT=y
# CONFIG_PREEMPT_NONE is not set
# CONFIG_PREEMPT_VOLUNTARY is not set
CONFIG_PREEMPT_LL=y

# CONFIG_BOUNCE is not set
CONFIG_ZSMALLOC=y
CONFIG_ZSMALLOC_STAT=y
CONFIG_RANDOMIZE_BASE=y

# Kernel command line
CONFIG_CMDLINE="console=tty0 console=ttyMT3,921600n1 root=/dev/ram vmalloc=496M slub_max_order=0 slub_debug=O"
# CONFIG_CMDLINE_FROM_BOOTLOADER is not set
# CONFIG_CMDLINE_EXTEND is not set

# EFI
# CONFIG_EFI is not set

# Memory
# CONFIG_CORE_DUMP_DEFAULT_ELF_HEADERS is not set
CONFIG_COMPAT=y
CONFIG_WQ_POWER_EFFICIENT_DEFAULT=y

# ============================================
# CPU Freq / Thermal
# ============================================
CONFIG_CPU_FREQ=y
CONFIG_CPU_FREQ_STAT=y
CONFIG_CPU_FREQ_DEFAULT_GOV_SCHEDUTIL=y
CONFIG_CPU_FREQ_GOV_POWERSAVE=y
CONFIG_CPU_FREQ_GOV_USERSPACE=y
CONFIG_CPU_FREQ_GOV_ONDEMAND=y
CONFIG_CPU_FREQ_GOV_CONSERVATIVE=y

# Thermal
CONFIG_THERMAL=y
CONFIG_THERMAL_GOV_STEP_WISE=y
CONFIG_THERMAL_GOV_FAIR_SHARE=y

# ============================================
# Networking
# ============================================
CONFIG_XFRM_MIGRATE=y
CONFIG_SYN_COOKIES=y
CONFIG_BRIDGE=y
CONFIG_BRIDGE_NETFILTER=y
CONFIG_VLAN_8021Q=y

# Netfilter
CONFIG_NETFILTER=y
CONFIG_NF_CONNTRACK=y
CONFIG_NF_CONNTRACK_EVENTS=y
CONFIG_NF_CONNTRACK_AMANDA=y
CONFIG_NF_CONNTRACK_FTP=y
CONFIG_NF_CONNTRACK_H323=y
CONFIG_NF_CONNTRACK_IRC=y
CONFIG_NF_CONNTRACK_NETBIOS_NS=y
CONFIG_NF_CONNTRACK_PPTP=y
CONFIG_NF_CONNTRACK_SANE=y
CONFIG_NF_CONNTRACK_SIP=y
CONFIG_NF_CONNTRACK_TFTP=y
CONFIG_NF_CT_NETLINK=y
CONFIG_NF_NAT=y
CONFIG_NF_NAT_AMANDA=y
CONFIG_NF_NAT_FTP=y
CONFIG_NF_NAT_IRC=y
CONFIG_NF_NAT_SIP=y
CONFIG_NF_NAT_TFTP=y
CONFIG_NF_NAT_REDIRECT=y
CONFIG_NF_NAT_MASQUERADE=y

# ============================================
# Mediatek Platform Drivers (Patch gerektirir)
# ============================================
CONFIG_MTK_IRQ=y
CONFIG_MTK_SYSIRQ=y
CONFIG_MTK_TIMER=y
CONFIG_MTK_SCPSYS=y
CONFIG_MTK_PMIC_WRAP=y
CONFIG_MTK_DEVAPC=y
CONFIG_MTK_CMDQ=y
CONFIG_MTK_SMI=y
CONFIG_MTK_MMSYS=y
CONFIG_MTK_DRAMC=y
CONFIG_MTK_EMI=y
CONFIG_MTK_EMI_BWL=y
CONFIG_MTK_EMI_MPU=y
CONFIG_MTK_CPUFREQ=y
CONFIG_MTK_INFRACFG=y
CONFIG_MTK_TOPCKGEN=y
CONFIG_MTK_DEVINFO=y
CONFIG_MTK_LCM=y
CONFIG_MTK_FB=y
CONFIG_MTK_DISP=y
CONFIG_MTK_MDP=y
CONFIG_MTK_VCODEC=y
CONFIG_MTK_VPU=y
CONFIG_MTK_CAM=y
CONFIG_MTK_IMGSYS=y
CONFIG_MTK_ISP=y
CONFIG_MTK_CCU=y
CONFIG_MTK_SENSOR=y
CONFIG_MTK_LEDS=y
CONFIG_MTK_VIBRATOR=y
CONFIG_MTK_SOUND=y
CONFIG_MTK_AUDIO=y
CONFIG_MTK_BTIF=y
CONFIG_MTK_CCCI=y
CONFIG_MTK_ECCCI=y
CONFIG_MTK_GPS=y
CONFIG_MTK_FM=y
CONFIG_MTK_WLAN=y
CONFIG_MTK_BT=y
CONFIG_MTK_NFC=y
CONFIG_MTK_USB=y
CONFIG_MTK_MUSB=y
CONFIG_MTK_USB20=y
CONFIG_MTK_USB_TYPEC=y
CONFIG_MTK_TYPEC_MT6370=y
CONFIG_MTK_MMC=y
CONFIG_MTK_SPI=y
CONFIG_MTK_I2C=y
CONFIG_MTK_PWM=y
CONFIG_MTK_GPIO=y
CONFIG_MTK_PINCTRL=y
CONFIG_MTK_CLK=y
CONFIG_MTK_REGULATOR=y
CONFIG_MTK_POWER=y
CONFIG_MTK_BATTERY=y
CONFIG_MTK_CHARGER=y
CONFIG_MTK_FG=y
CONFIG_MTK_GAUGE=y
CONFIG_MTK_CHARGER_MT6370=y
CONFIG_MTK_BATTERY_MT6370=y
CONFIG_MTK_GAUGE_MT6370=y
CONFIG_MTK_MT6360=y
CONFIG_MTK_TYPEC=y
CONFIG_MTK_USB_PD=y
CONFIG_MTK_DP=y
CONFIG_MTK_DRM=y
CONFIG_MTK_GPU=y
CONFIG_MTK_MALI=y
CONFIG_MTK_GZ=y
CONFIG_MTK_TEE=y
CONFIG_MTK_GENIEZONE=y
CONFIG_MTK_DEVMPU=y
CONFIG_MTK_GCPU=y
CONFIG_MTK_DEBUG=y
CONFIG_MTK_RAM_CONSOLE=y
CONFIG_MTK_LASTPC=y
CONFIG_MTK_PERF=y
CONFIG_MTK_TASK_TURBO=y
CONFIG_MTK_IO_BOOST=y
CONFIG_MTK_PMIC_MT6358=y
CONFIG_MTK_PMIC_MT6370=y
CONFIG_MTK_SUBPMIC=y
CONFIG_MTK_SCP=y
CONFIG_MTK_ADSP=y
CONFIG_MTK_APU=y
CONFIG_MTK_HIFI_DSP=y
CONFIG_MTK_VOW=y
CONFIG_MTK_ULTRA=y
CONFIG_MTK_AURISYS=y
CONFIG_MTK_CCCI=y
CONFIG_MTK_ECCCI=y
CONFIG_MTK_CCMNI=y
CONFIG_MTK_MDDP=y
CONFIG_MTK_C2K_USB=y
CONFIG_MTK_CONN_MD=y
CONFIG_MTK_AEE=y
CONFIG_MTK_LOGGER=y
CONFIG_MTK_MLOG=y
CONFIG_MTK_BOOT=y
CONFIG_MTK_BOOT_REASON=y
CONFIG_MTK_RTC=y
CONFIG_MTK_WDT=y
CONFIG_MTK_UART=y
CONFIG_MTK_CQDMA=y
CONFIG_MTK_M4U=y
CONFIG_MTK_PSEUDO_M4U=y
CONFIG_MTK_DVFSRC=y
CONFIG_MTK_LPM=y
CONFIG_MTK_SPM=y
CONFIG_MTK_SLEEP=y
CONFIG_MTK_SSPM=y
CONFIG_MTK_MCUPM=y
CONFIG_MTK_CLKBUF=y
CONFIG_MTK_DCXO=y
CONFIG_MTK_AUXADC=y
CONFIG_MTK_ACCDET=y
CONFIG_MTK_CAMERAISP=y
CONFIG_MTK_IMGSENSOR=y
CONFIG_MTK_CAM_CAL=y
CONFIG_MTK_LENS=y
CONFIG_MTK_FLASHLIGHT=y
CONFIG_MALI_MIDGARD=y
CONFIG_MALI_BIFROST=y
CONFIG_MALI_PLATFORM_THIRDPARTY=y
CONFIG_MALI_PLATFORM_THIRDPARTY_NAME="mt6768"
CONFIG_MTK_PCIE=y
CONFIG_MTK_NAND=y
CONFIG_MTK_TRUSTED_MEMORY=y
CONFIG_MTK_SYSTRACKER=y
CONFIG_MTK_DBGTOP=y
CONFIG_MTK_MMP=y
CONFIG_MTK_MET_DRV=y
CONFIG_MTK_MEMORY_SSMR=y
CONFIG_MTK_MEMORY_AMMS=y
CONFIG_MTK_ZONE_MOVABLE_CMA=y
CONFIG_MTK_L3C_PART=y
CONFIG_MTK_PID_MAP=y
CONFIG_MTK_RT_REGMAP=y
CONFIG_MTK_SCHED=y
CONFIG_MTK_BLOCKTAG=y
CONFIG_MTK_LOG_STORE=y
CONFIG_MTK_RPS=y
CONFIG_MTK_SYNC=y
CONFIG_MTK_UDI=y
CONFIG_MTK_DFD=y
CONFIG_MTK_ICE_DEBUG=y
CONFIG_MTK_DEBUG_LATCH=y
CONFIG_MTK_CMO=y
CONFIG_MTK_MASP=y
CONFIG_MTK_OTP=y
CONFIG_MTK_PARTITION=y
CONFIG_MTK_SAR_HUB=y
CONFIG_MTK_ELLIPTIC=y
CONFIG_MTK_IRTX=y
CONFIG_MTK_IRRX=y
CONFIG_MTK_CACHE_AUDITOR=y
CONFIG_MTK_FREQHOPPING=y
CONFIG_MTK_CIRQ=y
CONFIG_MTK_FIQ_CACHE=y
CONFIG_MTK_TINYSYS_SCP=y
CONFIG_MTK_AUDIO_IPI=y
CONFIG_MTK_AUDIO_SCP=y
CONFIG_MTK_HIFIDSP_AUDIO_IPI=y
CONFIG_MTK_DRAMC=y
CONFIG_MTK_SND_SOC=y

# ============================================
# Common Clock Mediatek (5.10 mainline)
# ============================================
CONFIG_COMMON_CLK_MEDIATEK=y
CONFIG_COMMON_CLK_MT6768=y
CONFIG_COMMON_CLK_MT6768_MMSYS=y
CONFIG_COMMON_CLK_MT6768_IMGSYS=y
CONFIG_COMMON_CLK_MT6768_VDECSYS=y
CONFIG_COMMON_CLK_MT6768_VENCSYS=y
CONFIG_COMMON_CLK_MT6768_MFGCFG=y
CONFIG_COMMON_CLK_MT6768_AUDSYS=y

# ============================================
# IOMMU (5.10 mainline)
# ============================================
CONFIG_IOMMU_IO_PGTABLE_LPAE=y
CONFIG_MTK_IOMMU=y

# ============================================
# Android / GKI
# ============================================
CONFIG_ANDROID=y
CONFIG_ANDROID_BINDER_IPC=y
CONFIG_ANDROID_BINDERFS=y
CONFIG_ANDROID_BINDER_DEVICES="binder,hwbinder,vndbinder"
CONFIG_ANDROID_LOW_MEMORY_KILLER=y
CONFIG_ANDROID_LOW_MEMORY_KILLER_AUTODETECT_OOM_ADJ_VALUES=y
CONFIG_ASHMEM=y

# ============================================
# Modules
# ============================================
CONFIG_MODULES=y
CONFIG_MODULE_UNLOAD=y
CONFIG_MODVERSIONS=y
CONFIG_MODULE_SIG=y
CONFIG_MODULE_SIG_FORCE=y
CONFIG_MODULE_SIG_SHA256=y

# ============================================
# 5.10 Mainline Gereksinimleri
# ============================================
CONFIG_ARM64=y
CONFIG_64BIT=y
CONFIG_MMU=y
CONFIG_ARCH_PHYS_ADDR_T_64BIT=y
CONFIG_ZONE_DMA32=y
CONFIG_ARCH_DMA_ADDR_T_64BIT=y
CONFIG_SWIOTLB=y
CONFIG_IOMMU_SUPPORT=y
CONFIG_OF=y
CONFIG_OF_OVERLAY=y
CONFIG_OF_ALL_DTBS=y

# Device Tree
CONFIG_DTC=y
CONFIG_PROC_DEVICETREE=y

# Crypto
CONFIG_CRYPTO=y
CONFIG_CRYPTO_AES=y
CONFIG_CRYPTO_ANSI_CPRNG=y
CONFIG_CRYPTO_SHA256=y
CONFIG_CRYPTO_SHA256_ARM64=y

# Security
CONFIG_SECURITY=y
CONFIG_SECURITY_SELINUX=y
CONFIG_SECURITY_SELINUX_BOOTPARAM=y

# Block
CONFIG_BLOCK=y
CONFIG_BLK_MQ_PCI=y
CONFIG_BLK_MQ_PCIE=y

# SCSI / SATA
CONFIG_SCSI=y
CONFIG_BLK_DEV_SD=y

# MMC
CONFIG_MMC=y
CONFIG_MMC_BLOCK=y
CONFIG_MMC_BLOCK_MINORS=32
CONFIG_MMC_SDHCI=y
CONFIG_MMC_SDHCI_PLTFM=y
CONFIG_MMC_MTK=y

# PHY
CONFIG_PHY_MTK_TPHY=y
CONFIG_PHY_MTK_UFS=y
CONFIG_PHY_MTK_MIPI_DSI=y

# PCI
CONFIG_PCI=y
CONFIG_PCIEPORTBUS=y
CONFIG_PCIE_PME=y

# USB
CONFIG_USB=y
CONFIG_USB_SUPPORT=y
CONFIG_USB_XHCI_HCD=y
CONFIG_USB_XHCI_MTK=y
CONFIG_USB_EHCI_HCD=y
CONFIG_USB_OHCI_HCD=y
CONFIG_USB_STORAGE=y
CONFIG_USB_UAS=y
CONFIG_USB_GADGET=y
CONFIG_USB_CONFIGFS=y
CONFIG_USB_CONFIGFS_F_FS=y
CONFIG_USB_CONFIGFS_RNDIS=y
CONFIG_USB_CONFIGFS_MASS_STORAGE=y

# RTC
CONFIG_RTC_CLASS=y
CONFIG_RTC_DRV_MT6397=y

# Watchdog
CONFIG_WATCHDOG=y
CONFIG_WATCHDOG_CORE=y
CONFIG_MEDIATEK_WATCHDOG=y

# SPI
CONFIG_SPI=y
CONFIG_SPI_MASTER=y
CONFIG_SPI_MEM=y
CONFIG_SPI_MTK_NOR=y

# I2C
CONFIG_I2C=y
CONFIG_I2C_CHARDEV=y
CONFIG_I2C_MT65XX=y

# PWM
CONFIG_PWM=y
CONFIG_PWM_MTK_DISP=y
CONFIG_PWM_MEDIATEK=y

# GPIO
CONFIG_GPIOLIB=y
CONFIG_GPIO_SYSFS=y
CONFIG_GPIO_MTK=y

# Pinctrl
CONFIG_PINCTRL=y
CONFIG_PINCTRL_MTK=y
CONFIG_PINCTRL_MT6768=y

# Regulator
CONFIG_REGULATOR=y
CONFIG_REGULATOR_FIXED_VOLTAGE=y
CONFIG_REGULATOR_MT6358=y
CONFIG_REGULATOR_MT6370=y

# CLK
CONFIG_HAVE_CLK=y
CONFIG_CLKDEV_LOOKUP=y
CONFIG_COMMON_CLK=y

# Power
CONFIG_POWER_SUPPLY=y
CONFIG_POWER_RESET=y
CONFIG_POWER_RESET_SYSCON=y

# Battery
CONFIG_BATTERY_MTK=y

# Charger
CONFIG_CHARGER_MTK=y

# LED
CONFIG_NEW_LEDS=y
CONFIG_LEDS_CLASS=y
CONFIG_LEDS_MTK=y

# Input
CONFIG_INPUT=y
CONFIG_INPUT_EVDEV=y
CONFIG_INPUT_KEYRESET=y
CONFIG_KEYBOARD_MTK=y
CONFIG_TOUCHSCREEN_MTK=y

# Sound
CONFIG_SOUND=y
CONFIG_SND=y
CONFIG_SND_SOC=y
CONFIG_SND_SOC_MTK=y
CONFIG_SND_SOC_MT6358=y
CONFIG_SND_SOC_MT6370=y

# DMA
CONFIG_DMADEVICES=y
CONFIG_MTK_HSDMA=y
CONFIG_MTK_CQDMA=y

# Mailbox
CONFIG_MAILBOX=y
CONFIG_MTK_CMDQ_MBOX=y

# Remoteproc
CONFIG_REMOTEPROC=y
CONFIG_MTK_SCP_REMOTEPROC=y

# RPMSG
CONFIG_RPMSG=y
CONFIG_RPMSG_MTK_SCP=y

# SOC
CONFIG_MTK_INFRACFG=y
CONFIG_MTK_PMIC=y
CONFIG_MTK_SCPSYS=y
CONFIG_MTK_MMSYS=y

# DRM
CONFIG_DRM=y
CONFIG_DRM_MEDIATEK=y
CONFIG_DRM_PANEL_ORIENTATION_QUIRKS=y

# FB
CONFIG_FB=y
CONFIG_FB_CMDLINE=y
CONFIG_FB_NOTIFY=y

# Backlight
CONFIG_BACKLIGHT_CLASS_DEVICE=y
CONFIG_BACKLIGHT_PWM=y

# Console
CONFIG_VT=y
CONFIG_CONSOLE_TRANSLATIONS=y
CONFIG_VT_CONSOLE=y
CONFIG_HW_CONSOLE=y
CONFIG_UNIX98_PTYS=y
CONFIG_DEVPTS_MULTIPLE_INSTANCES=y

# TTY
CONFIG_TTY=y
CONFIG_SERIAL_CORE=y
CONFIG_SERIAL_CORE_CONSOLE=y
CONFIG_SERIAL_8250=y
CONFIG_SERIAL_8250_CONSOLE=y
CONFIG_SERIAL_8250_MT6577=y
CONFIG_SERIAL_OF_PLATFORM=y

# Random
CONFIG_HW_RANDOM=y
CONFIG_HW_RANDOM_MTK=y

# DMA BUF
CONFIG_DMA_SHARED_BUFFER=y

# Ion
CONFIG_ION=y
CONFIG_ION_SYSTEM_HEAP=y
CONFIG_ION_CARVEOUT_HEAP=y
CONFIG_ION_CHUNK_HEAP=y
CONFIG_ION_MTK=y

# DMA-BUF Heaps
CONFIG_DMABUF_HEAPS=y
CONFIG_DMABUF_HEAPS_SYSTEM=y
CONFIG_DMABUF_HEAPS_CMA=y

# Staging
CONFIG_STAGING=y

# Firmware
CONFIG_FW_LOADER=y
CONFIG_EXTRA_FIRMWARE=""

# Virtualization
# CONFIG_VIRTUALIZATION is not set
```
